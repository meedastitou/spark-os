## spark/spark-os/spark/configs/spark_x86_64_defconfig
```kconfig
BR2_x86_64=y
BR2_CCACHE=y
BR2_GLOBAL_PATCH_DIR="../spark/board/spark/common/patches"
BR2_TOOLCHAIN_BUILDROOT_GLIBC=y
BR2_TOOLCHAIN_BUILDROOT_CXX=y
BR2_TARGET_GENERIC_HOSTNAME=""
BR2_TARGET_GENERIC_ISSUE="Welcome to Spark"
BR2_INIT_SYSTEMD=y
# BR2_TARGET_ENABLE_ROOT_LOGIN is not set
BR2_TARGET_GENERIC_GETTY_PORT="ttyS0"
BR2_ENABLE_LOCALE_WHITELIST="C en en_GB en_US"
BR2_ROOTFS_USERS_TABLES="../spark/board/spark/common/users_table.txt"
BR2_ROOTFS_OVERLAY="../spark/board/spark/common/skel ../spark/board/spark/x86_64/skel"
BR2_ROOTFS_POST_BUILD_SCRIPT="../spark/board/spark/x86_64/post_build.sh"
BR2_ROOTFS_POST_IMAGE_SCRIPT="../spark/board/spark/x86_64/post_image.sh"
BR2_ROOTFS_POST_SCRIPT_ARGS="$(LINUX_DIR)"
BR2_LINUX_KERNEL=y
BR2_LINUX_KERNEL_USE_CUSTOM_CONFIG=y
BR2_LINUX_KERNEL_CUSTOM_CONFIG_FILE="../spark/board/spark/x86_64/linux/linux_defconfig"
BR2_LINUX_KERNEL_XZ=y
BR2_LINUX_KERNEL_INSTALL_TARGET=y
BR2_PACKAGE_BUSYBOX_CONFIG_FRAGMENT_FILES="../spark/board/spark/common/busybox.fragment"
BR2_PACKAGE_GDB=y
BR2_PACKAGE_GDB_SERVER=y
BR2_PACKAGE_GDB_DEBUGGER=y
BR2_PACKAGE_STRACE=y
BR2_PACKAGE_DOSFSTOOLS=y
BR2_PACKAGE_DOSFSTOOLS_FATLABEL=y
BR2_PACKAGE_DOSFSTOOLS_FSCK_FAT=y
BR2_PACKAGE_DOSFSTOOLS_MKFS_FAT=y
BR2_PACKAGE_E2FSPROGS=y
BR2_PACKAGE_E2FSPROGS_RESIZE2FS=y
BR2_PACKAGE_LINUX_FIRMWARE=y
BR2_PACKAGE_LINUX_FIRMWARE_RALINK_RT2XX=y
BR2_PACKAGE_LINUX_FIRMWARE_RTL_81XX=y
BR2_PACKAGE_LINUX_FIRMWARE_RTL_87XX=y
BR2_PACKAGE_DFU_UTIL=y
BR2_PACKAGE_I2C_TOOLS=y
BR2_PACKAGE_KBD=y
BR2_PACKAGE_PICOCOM=y
BR2_PACKAGE_USBUTILS=y
BR2_PACKAGE_NODEJS_MODULES_ADDITIONAL="bunyan@1.8.12"
BR2_PACKAGE_LIBOPENSSL_BIN=y
BR2_PACKAGE_LIBCURL=y
BR2_PACKAGE_CURL=y
BR2_PACKAGE_ICU=y
BR2_PACKAGE_BLUEZ_TOOLS=y
BR2_PACKAGE_BLUEZ5_UTILS=y
BR2_PACKAGE_BLUEZ5_UTILS_CLIENT=y
BR2_PACKAGE_BLUEZ5_UTILS_DEPRECATED=y
BR2_PACKAGE_CONNMAN=y
BR2_PACKAGE_CONNMAN_WIFI=y
BR2_PACKAGE_CONNMAN_BLUETOOTH=y
BR2_PACKAGE_CONNMAN_LOOPBACK=y
BR2_PACKAGE_CONNMAN_DEBUG=y
BR2_PACKAGE_CONNMAN_CLIENT=y
BR2_PACKAGE_CRDA=y
BR2_PACKAGE_DNSMASQ=y
# BR2_PACKAGE_DNSMASQ_TFTP is not set
# BR2_PACKAGE_DNSMASQ_DHCP is not set
BR2_PACKAGE_NETSNMP=y
BR2_PACKAGE_NETSNMP_WITH_MIB_MODULES="host misc/ipfwacc ucd-snmp/diskio tunnel ucd-snmp/dlmod agentx agent/extend"
BR2_PACKAGE_NGINX=y
BR2_PACKAGE_NGINX_HTTP_CACHE=y
BR2_PACKAGE_NGINX_HTTP_SSL_MODULE=y
BR2_PACKAGE_NGINX_HTTP_V2_MODULE=y
BR2_PACKAGE_NGINX_HTTP_GZIP_STATIC_MODULE=y
# BR2_PACKAGE_NGINX_HTTP_CHARSET_MODULE is not set
# BR2_PACKAGE_NGINX_HTTP_SSI_MODULE is not set
# BR2_PACKAGE_NGINX_HTTP_USERID_MODULE is not set
# BR2_PACKAGE_NGINX_HTTP_ACCESS_MODULE is not set
# BR2_PACKAGE_NGINX_HTTP_AUTH_BASIC_MODULE is not set
# BR2_PACKAGE_NGINX_HTTP_AUTOINDEX_MODULE is not set
# BR2_PACKAGE_NGINX_HTTP_GEO_MODULE is not set
# BR2_PACKAGE_NGINX_HTTP_MAP_MODULE is not set
# BR2_PACKAGE_NGINX_HTTP_SPLIT_CLIENTS_MODULE is not set
# BR2_PACKAGE_NGINX_HTTP_REFERER_MODULE is not set
# BR2_PACKAGE_NGINX_HTTP_FASTCGI_MODULE is not set
# BR2_PACKAGE_NGINX_HTTP_UWSGI_MODULE is not set
# BR2_PACKAGE_NGINX_HTTP_SCGI_MODULE is not set
# BR2_PACKAGE_NGINX_HTTP_MEMCACHED_MODULE is not set
# BR2_PACKAGE_NGINX_HTTP_LIMIT_CONN_MODULE is not set
# BR2_PACKAGE_NGINX_HTTP_LIMIT_REQ_MODULE is not set
# BR2_PACKAGE_NGINX_HTTP_EMPTY_GIF_MODULE is not set
# BR2_PACKAGE_NGINX_HTTP_BROWSER_MODULE is not set
# BR2_PACKAGE_NGINX_HTTP_UPSTREAM_IP_HASH_MODULE is not set
# BR2_PACKAGE_NGINX_HTTP_UPSTREAM_LEAST_CONN_MODULE is not set
# BR2_PACKAGE_NGINX_HTTP_UPSTREAM_KEEPALIVE_MODULE is not set
BR2_PACKAGE_NGINX_STREAM=y
BR2_PACKAGE_NGINX_STREAM_SSL_MODULE=y
# BR2_PACKAGE_NGINX_STREAM_LIMIT_CONN_MODULE is not set
# BR2_PACKAGE_NGINX_STREAM_ACCESS_MODULE is not set
# BR2_PACKAGE_NGINX_STREAM_UPSTREAM_HASH_MODULE is not set
# BR2_PACKAGE_NGINX_STREAM_UPSTREAM_LEAST_CONN_MODULE is not set
# BR2_PACKAGE_NGINX_STREAM_UPSTREAM_ZONE_MODULE is not set
BR2_PACKAGE_NGINX_DEBUG=y
BR2_PACKAGE_NMAP=y
BR2_PACKAGE_OPENSSH=y
BR2_PACKAGE_RSYNC=y
BR2_PACKAGE_SOCAT=y
BR2_PACKAGE_TCPDUMP=y
BR2_PACKAGE_WIRELESS_TOOLS=y
BR2_PACKAGE_WIRELESS_TOOLS_LIB=y
BR2_PACKAGE_WPA_SUPPLICANT_EAP=y
BR2_PACKAGE_WPA_SUPPLICANT_WPS=y
BR2_PACKAGE_WPA_SUPPLICANT_DBUS_INTROSPECTION=y
BR2_PACKAGE_SUDO=y
BR2_PACKAGE_ACL=y
BR2_PACKAGE_OPENVMTOOLS=y
# BR2_PACKAGE_SYSTEMD_NETWORKD is not set
BR2_PACKAGE_SYSTEMD_POLKIT=y
# BR2_PACKAGE_SYSTEMD_RESOLVED is not set
# BR2_PACKAGE_SYSTEMD_TIMESYNCD is not set
BR2_PACKAGE_UTIL_LINUX_RFKILL=y
BR2_PACKAGE_NANO=y
BR2_TARGET_ROOTFS_SQUASHFS=y
BR2_TARGET_ROOTFS_SQUASHFS4_XZ=y
# BR2_TARGET_ROOTFS_TAR is not set
BR2_TARGET_SYSLINUX=y
BR2_TARGET_SYSLINUX_MBR=y
BR2_PACKAGE_HOST_DOSFSTOOLS=y
BR2_PACKAGE_HOST_GENIMAGE=y
BR2_PACKAGE_HOST_MTOOLS=y
BR2_PACKAGE_HOST_ZIP=y
BR2_PACKAGE_CA_CERTIFICATES_TE=y
BR2_PACKAGE_SPARK_HARDWARE=y
BR2_PACKAGE_SPARK_HEALTH_MONITOR=y
BR2_PACKAGE_SPARK_MQTT_BROKER=y
BR2_PACKAGE_SPARK_SERVICE_CLIENT=y
BR2_PACKAGE_SPARK_WEB_PROXY=y
BR2_PACKAGE_SPARK_WEBADMIN=y
```

## spark/spark-os/spark/package/Config.in
```kconfig
source "$BR2_EXTERNAL_SPARK_PATH/package/ca-certificates-te/Config.in"
source "$BR2_EXTERNAL_SPARK_PATH/package/spark-hardware/Config.in"
source "$BR2_EXTERNAL_SPARK_PATH/package/spark-health-monitor/Config.in"
source "$BR2_EXTERNAL_SPARK_PATH/package/spark-mqtt-broker/Config.in"
source "$BR2_EXTERNAL_SPARK_PATH/package/spark-protocol/Config.in"
source "$BR2_EXTERNAL_SPARK_PATH/package/spark-service-client/Config.in"
source "$BR2_EXTERNAL_SPARK_PATH/package/spark-web-proxy/Config.in"
source "$BR2_EXTERNAL_SPARK_PATH/package/spark-webadmin/Config.in"
```

## spark/spark-os/spark/package/ca-certificates-te/Config.in
```kconfig
config BR2_PACKAGE_CA_CERTIFICATES_TE
	bool "ca-certificates-te"
	select BR2_PACKAGE_CA_CERTIFICATES
	help
	  TE Certificates
```

## spark/spark-os/spark/package/spark-hardware/Config.in
```kconfig
config BR2_PACKAGE_SPARK_HARDWARE
	bool "spark-hardware"
	select BR2_PACKAGE_NODEJS
	select BR2_PACKAGE_REDIS
	select BR2_PACKAGE_LIBUSB
	select BR2_PACKAGE_HOST_YARN
	help
	  Spark Hardware layer

config BR2_PACKAGE_SPARK_HARDWARE_MODULES
	string "Additional modules"
	help
	  List of space-separated spark plugins to install.
```

## spark/spark-os/spark/package/spark-health-monitor/Config.in
```kconfig
config BR2_PACKAGE_SPARK_HEALTH_MONITOR
	bool "spark-health-monitor"
	select BR2_PACKAGE_NODEJS
	select BR2_PACKAGE_HOST_YARN
	help
	  Spark Health Monitor
```

## spark/spark-os/spark/package/spark-mqtt-broker/Config.in
```kconfig
config BR2_PACKAGE_SPARK_MQTT_BROKER
	bool "spark-mqtt-broker"
	select BR2_PACKAGE_NODEJS
	select BR2_PACKAGE_HOST_YARN
	help
	  Spark MQTT Broker
```

## spark/spark-os/spark/package/spark-protocol/Config.in
```kconfig
config BR2_PACKAGE_SPARK_PROTOCOL
	bool "spark-protocol"
	select BR2_PACKAGE_NODEJS
	select BR2_PACKAGE_REDIS
	select BR2_PACKAGE_HOST_YARN
	help
	  Spark Protocol layer

config BR2_PACKAGE_SPARK_PROTOCOL_MODULES
	string "Additional modules"
	help
	  List of space-separated spark plugins to install.
```

## spark/spark-os/spark/package/spark-service-client/Config.in
```kconfig
config BR2_PACKAGE_SPARK_SERVICE_CLIENT
	bool "spark-service-client"
	select BR2_PACKAGE_NODEJS
	select BR2_PACKAGE_HOST_YARN
	help
	  Spark Service Client
```

## spark/spark-os/spark/package/spark-web-proxy/Config.in
```kconfig
config BR2_PACKAGE_SPARK_WEB_PROXY
	bool "spark-web-proxy"
	select BR2_PACKAGE_NODEJS
	select BR2_PACKAGE_LIBPCAP
	select BR2_PACKAGE_HOST_YARN
	help
	  Spark HTTP & HTTPS Proxy
```

## spark/spark-os/spark/package/spark-webadmin/Config.in
```kconfig
config BR2_PACKAGE_SPARK_WEBADMIN
	bool "spark-webadmin"
	select BR2_PACKAGE_NODEJS
	select BR2_PACKAGE_SPARK_PROTOCOL
	select BR2_PACKAGE_HOST_YARN
	help
	  Spark WebAdmin Interface
```
